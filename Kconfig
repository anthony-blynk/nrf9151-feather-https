## Kconfig
```kconfig
mainmenu "Application Configuration"

config BLYNK_SERVER
    string "Blynk Server"
    default ""
    
config BLYNK_AUTH_TOKEN
    string "Blynk Auth Token"
    default ""

config DEFAULT_DELAY
    int "Update interval (minutes)"
    default 1440

rsource "src/cloud/Kconfig"
source "Kconfig.zephyr"
```

## src/cloud/Kconfig
```kconfig
mainmenu "Application Cloud Configuration"

config CLOUD_TLS_SEC_TAG
    int "TLS Sec Tag"
    default 42

config CLOUD_HOSTNAME
	string "Base URL"
	default "webhook.site"

config CLOUD_PORT
    int "Port"
    default 443

config CLOUD_PUBLISH_PATH
    string "Publish Path"
    default "/2574b574-4f74-40d6-aef4-fe5841878008"
```
